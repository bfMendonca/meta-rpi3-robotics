## conf/distro/robotics.conf
```bitbake
require conf/distro/poky.conf

#Nome da distribuição
DISTRO = "robotics"
DISTRO_NAME = "RPI3 Robotics + ROS & QT Distribution"
DISTRO_VERSION = "1.0"
DISTRO_CODENAME = "rbtc"

DISTRO_FEATURES_append = "ext2 pam opengl usbhost ${DISTRO_FEATURES_LIBC}"
DISTRO_FEATURES_BACKFILL_CONSIDERED += "pulseaudio"
DISTRO_FEATURES_remove = "  opengl wayland"

SDK_VENDOR = "-roboticssdk"
SDK_VERSION := "${@'${DISTRO_VERSION}'.replace('snapshot-${DATE}','snapshot')}"
MAINTAINER = "Bruno Mendonca "
INHERIT += "buildhistory"
BUILDHISTORY_COMMIT = "1"
```
